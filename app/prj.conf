## CMakeLists.txt
```
# BMS 应用 CMake —— Zephyr application
cmake_minimum_required(VERSION 3.20.0)

find_package(Zephyr REQUIRED HINTS $ENV{ZEPHYR_BASE})
project(bms_app LANGUAGES C)

# 模块公共头（对外接口）
target_include_directories(app PRIVATE include)

# 把 git 版本编进固件，供现场/日志追溯（呼应 foxBMS VER_VERSION_s）。git describe
# 在 configure 时取值：--always 无 tag 退化为 hash、--dirty 标记工作树未提交改动、
# --tags 用最近 tag。非 git 环境回退 "unknown"。应用版本（语义化）由 Zephyr 从
# app/VERSION 自动生成的 <app_version.h> 提供。
execute_process(
  COMMAND git -C ${CMAKE_CURRENT_SOURCE_DIR} describe --always --dirty --tags --abbrev=12
  OUTPUT_VARIABLE BMS_GIT_DESCRIBE
  OUTPUT_STRIP_TRAILING_WHITESPACE
  ERROR_QUIET)
if(NOT BMS_GIT_DESCRIBE)
  set(BMS_GIT_DESCRIBE "unknown")
endif()
set(BMS_GENERATED_DIR ${CMAKE_CURRENT_BINARY_DIR}/include/generated)
configure_file(include/bms/build_info.h.in ${BMS_GENERATED_DIR}/bms/build_info.h @ONLY)
target_include_directories(app PRIVATE ${BMS_GENERATED_DIR})

# 健壮性：app 自有源码的编译告警视为错误（仅限 app 目标，不波及 Zephyr/modules）。
# 与 clang-tidy(WarningsAsErrors)/sca-gcc 形成互补，挡住编译器层告警。
# -Wswitch-default / -Wimplicit-fallthrough 落实 CS-18（switch 必有 default、禁隐式穿透）。
target_compile_options(app PRIVATE -Werror -Wswitch-default -Wimplicit-fallthrough)

# 核心源：main + compatibility zbus channel + foxBMS-style engine
target_sources(app PRIVATE
  src/main.c
  src/bms/engine/channels.c
  src/bms/engine/db.c
  src/bms/engine/diag.c
  src/bms/engine/time.c
  src/bms/engine/sys_mon.c
  src/bms/engine/task.c
  src/bms/application/bms.c
  src/bms/measurement-control/contactor/contactor.c
  src/bms/hal/contactor_io/contactor_io_fake.c
)

# 各 BMS 模块按 Kconfig 开关裁剪编译
target_sources_ifdef(CONFIG_BMS_AFE        app PRIVATE src/bms/hal/afe/afe.c)
# 测量可信化（measurement-control/meas）：raw → validity/时间戳 → DB（测量数据纪律）
target_sources_ifdef(CONFIG_BMS_AFE        app PRIVATE src/bms/measurement-control/meas/meas.c)
target_sources_ifdef(CONFIG_BMS_AFE        app PRIVATE src/bms/measurement-control/meas/meas_validate.c)
# afe 采样后端：三选一（choice 保证恰好一个 backend 提供 bms_afe_backend_read）
target_sources_ifdef(CONFIG_BMS_AFE_BACKEND_STUB app PRIVATE src/bms/hal/afe/afe_stub.c)
target_sources_ifdef(CONFIG_BMS_AFE_BACKEND_SIM  app PRIVATE src/bms/hal/afe/afe_sim.c)
target_sources_ifdef(CONFIG_BMS_AFE_BACKEND_ADC  app PRIVATE src/bms/hal/afe/afe_adc.c)
target_sources_ifdef(CONFIG_BMS_SOC        app PRIVATE src/bms/application/soc/soc.c)
target_sources_ifdef(CONFIG_BMS_PROTECTION app PRIVATE src/bms/measurement-control/protection/protection.c)
target_sources_ifdef(CONFIG_BMS_BALANCING  app PRIVATE src/bms/application/balancing/balancing.c)
target_sources_ifdef(CONFIG_BMS_COMM       app PRIVATE src/bms/application/comm/comm.c)
# comm 周期合法化（纯函数，运行期防御性钳制；单测只链此源）
target_sources_ifdef(CONFIG_BMS_COMM       app PRIVATE src/bms/application/comm/comm_period.c)
# 看门狗 hal 后端：二选一（stub=sim 无硬件狗 / stm32=真板 IWDG）
target_sources_ifdef(CONFIG_BMS_WDT_BACKEND_STUB  app PRIVATE src/bms/hal/wdt/wdt_stub.c)
target_sources_ifdef(CONFIG_BMS_WDT_BACKEND_STM32 app PRIVATE src/bms/hal/wdt/wdt_stm32.c)
```

## Kconfig
```
# BMS 应用级配置
mainmenu "BMS firmware configuration"

menu "BMS application"

config BMS_CELL_COUNT
	int "Number of series cells（串数）"
	range 1 256
	default 16
	help
	  电池组串联单体数量，决定每帧测量数组长度。

config BMS_TEMP_SENSOR_COUNT
	int "Number of temperature sensors（温度传感器数）"
	range 1 64
	default 4

config BMS_TASK_SAFETY_PERIOD_MS
	int "Safety cyclic task period (ms)"
	range 1 1000
	default 10
	help
	  foxBMS 2 inspired safety cyclic task period. This task evaluates
	  measurement/protection/BMS state machine work.

config BMS_TASK_APP_PERIOD_MS
	int "Application cyclic task period (ms)"
	range 10 60000
	default 100
	help
	  foxBMS 2 inspired application cyclic task period. This task runs
	  slower algorithms, balancing decisions, and communication reporting.

config BMS_AFE
	bool "AFE / 电芯采样模块"
	default y
	help
	  采集电压/电流/温度并写入 bms_db；周期由 bms_task 统一调度。

config BMS_AFE_SAMPLE_PERIOD_MS
	int "AFE 采样周期 (ms)"
	depends on BMS_AFE
	range 1 60000
	default 100

choice
	prompt "AFE 数据源后端"
	depends on BMS_AFE
	default BMS_AFE_BACKEND_SIM
	help
	  选择 afe 的采样实现后端（业务逻辑/线程不变，差异收敛到 bms_afe_backend_read()，
	  见 docs/concept/architecture.md「数据源后端可切换（afe）」）。

config BMS_AFE_BACKEND_STUB
	bool "stub（恒定桩数据）"
	help
	  返回固定电压/电流/温度，确定性最强，用于最小化烟雾测试。

config BMS_AFE_BACKEND_SIM
	bool "sim（充放电仿真模型）"
	help
	  三角充放电 + 库仑积分 + OCV 映射 + 温升，QEMU/native_sim 下产出"会动"的
	  可复现数据，供 soc/protection/balancing 拿到变化输入。

config BMS_AFE_BACKEND_ADC
	bool "adc（真实硬件，经 devicetree ADC/AFE 芯片）"
	help
	  真机后端：DEVICE_DT_GET 取 ADC/专用 AFE 芯片走设备 API。当前为占位，
	  待 bms_f405 板 dts 就绪后实现。

endchoice

# 测量合理性校验阈值（"读数是否物理可信"，区别于 protection 的保护阈值）。
# 取很宽的量程，只剔除明显坏帧（断线/量程溢出/ADC 异常），见架构「测量数据纪律」。
config BMS_MEAS_PLAUSIBLE_CELL_MV_MIN
	int "单体电压合理下限 (mV)"
	depends on BMS_AFE
	default 0

config BMS_MEAS_PLAUSIBLE_CELL_MV_MAX
	int "单体电压合理上限 (mV)"
	depends on BMS_AFE
	default 6000

config BMS_MEAS_PLAUSIBLE_CURRENT_ABS_MAX_MA
	int "电流绝对值合理上限 (mA)"
	depends on BMS_AFE
	default 300000

config BMS_MEAS_PLAUSIBLE_TEMP_DCI_MIN
	int "温度合理下限 (0.1℃)"
	depends on BMS_AFE
	default -400

config BMS_MEAS_PLAUSIBLE_TEMP_DCI_MAX
	int "温度合理上限 (0.1℃)"
	depends on BMS_AFE
	default 1250

config BMS_MEAS_STALE_TOLERANCE_MS
	int "Cell measurement staleness tolerance (ms)"
	default 300
	help
	  DB_CELL_MEAS 视为过期的时间容忍（now - timestamp 超过即判过期）。默认 3× 采样周期。

config BMS_SOC
	bool "SOC/SOH 估算模块"
	default y

config BMS_SOC_PACK_CAPACITY_MAH
	int "电池组额定容量 (mAh)"
	depends on BMS_SOC
	range 1 10000000
	default 100000
	help
	  库仑积分换算基准（额定容量，单位 mAh）。换算公式
	  ΔSOC(‰)=acc(mA·ms)/(容量×3600)。多板型适配请覆写，
	  禁止在算法中硬编码（REQ-SOC-C12）。

config BMS_SOC_INIT_FROM_VOLTAGE
	bool "上电用电压线性映射初始化 SOC 初值"
	depends on BMS_SOC
	default y
	help
	  y：首帧用 bms_soc_estimate 的电压映射(3000mV→0‰,4200mV→1000‰)
	  作为库仑积分起点（REQ-SOC-C04）。n：从 0‰ 起算（不推荐）。

config BMS_SOC_GAP_FACTOR_N
	int "丢帧判定因子 N（Δt 上限 = N × AFE 采样周期）"
	depends on BMS_SOC
	range 2 1000
	default 10
	help
	  帧间差 > N×CONFIG_BMS_AFE_SAMPLE_PERIOD_MS 判为丢帧，Δt 夹紧到
	  该上限，避免单帧 SOC 大幅跳变（REQ-SOC-C02-3、C06）。

config BMS_SOC_MAX_CURRENT_MA
	int "合理电流量程上限绝对值 (mA)"
	depends on BMS_SOC
	range 1 2000000
	default 200000
	help
	  |pack_current_ma| 超过此值判为坏数据，跳过本帧积分（REQ-SOC-C06）。
	  默认 ±200A，覆盖 C10 建议的 ±100A 测试量程并留裕量。

config BMS_PROTECTION
	bool "保护状态机模块"
	default y

config BMS_PROTECTION_PERIOD_MS
	int "保护评估周期 (ms)"
	depends on BMS_PROTECTION
	default 50

config BMS_BALANCING
	bool "单体均衡模块"
	default y

config BMS_COMM
	bool "CAN 通信模块"
	default y

config BMS_COMM_REPORT_PERIOD_MS
	int "CAN 上报周期 (ms)"
	depends on BMS_COMM
	range 10 60000
	default 200
	help
	  comm 模块对外 CAN 上报的固定周期（毫秒）。
	  下界 10ms 防止过密上报使最低优先级 comm 线程忙等、间接拖累
	  protection/afe 等安全相关线程（失效安全，REQ-COMM-005）；
	  上界 60000ms(60s) 为工程合理上限。默认 200ms 为现状基线。
	  运行期另有防御性钳制（bms_comm_clamp_period_ms）作第二道防线。
	  (DES-COMM-001; REQ-COMM-001/002/003/004)

choice BMS_WDT_BACKEND
	prompt "BMS 硬件看门狗后端"
	default BMS_WDT_BACKEND_STUB
	help
	  hal/wdt wrapper 后端。sim 板（native_sim/mps2/qmxx）用 stub（软件计数、无复位）；
	  真板（bms_f405）用 STM32 内部 IWDG。喂狗门控见 bms_sys_mon_wdt_feed_allowed。

config BMS_WDT_BACKEND_STUB
	bool "Stub（无硬件看门狗，sim）"

config BMS_WDT_BACKEND_STM32
	bool "STM32 IWDG（真板）"
	depends on WATCHDOG
endchoice

config BMS_WDT_TIMEOUT_MS
	int "硬件看门狗超时 (ms)"
	default 1000
	help
	  IWDG 超时窗口上界；喂狗须比此更频繁（safety 周期 10ms << 此值）。仅 STM32 后端用。

endmenu

# 必须在文件末尾引入 Zephyr 的 Kconfig 树
source "Kconfig.zephyr"
```

## prj.conf
```kconfig
# BMS 应用通用配置（与 board 无关的基础项）
#
# 本文件是「应用级」Kconfig 默认值，对所有 board 生效；board 专属项放各 board 的
# defconfig/overlay。最终生效值（合并 board defconfig + 命令行 -D 后）见 build/zephyr/.config。
# 各 CONFIG_* 的完整说明可在 `west build -t menuconfig` 中搜索，或查 Zephyr 文档。

# --- 日志 ---
CONFIG_LOG=y                     # 启用日志子系统（各模块的 LOG_INF/LOG_ERR 等）
CONFIG_LOG_MODE_DEFERRED=y       # 延迟模式：日志在独立线程异步处理，不阻塞调用线程，
                                 #   且可安全在中断/高优先级（如 protection）上下文打印
CONFIG_CBPRINTF_FP_SUPPORT=y     # 让日志格式化支持 %f 浮点（SOC permille→%、电压等）

# --- zbus 消息总线 ---
CONFIG_ZBUS=y                    # 启用 zbus：模块间唯一通信机制，发布/订阅 channel 实现解耦

# --- 线程 / 内核 ---
# main 线程栈大小（字节）；main 负责按 Kconfig 调各 bms_*_init()
# 注：int 型 CONFIG 的值后不能跟行内注释（会被并入数值导致 Kconfig 报错），故注释独占一行。
CONFIG_MAIN_STACK_SIZE=2048
CONFIG_THREAD_NAME=y             # 为线程保存可读名字，便于日志/调试时辨认（afe/soc/protection…）
CONFIG_THREAD_MONITOR=y          # 维护线程链表，支持 thread analyzer / 栈用量排查

# --- BMS 模块开关（详见 app/Kconfig；关掉某项则该模块不编译、不启动线程）---
CONFIG_BMS_AFE=y                 # afe：周期采样 cell 电压/电流/温度，发布 chan_cell_meas
CONFIG_BMS_SOC=y                 # soc：库仑计 SOC/SOH 估算，订阅 meas、发布 chan_soc
CONFIG_BMS_PROTECTION=y          # protection：OV/UV/OC/OT 状态机 + 接触器控制（安全关键，最高优先级）
CONFIG_BMS_BALANCING=y           # balancing：单体均衡，算出需放电的 bit-mask
CONFIG_BMS_COMM=y                # comm：快照各 channel 经 CAN 上报（仿真下打日志）
```

## boards/bms_f405.conf
```kconfig
# bms_f405 板上应用配置（第二步）
# 真实硬件外设使能（待 board dts 配好节点后开启）：
# CONFIG_ADC=y
# CONFIG_CAN=y
# CONFIG_GPIO=y
```

## boards/mps2_an386.conf
```kconfig
# mps2/an386 专属配置（Windows 上的 PC 仿真目标，Cortex-M4F）
#
# 选用 mps2/an386 作为仿真目标：与 STM32F405 同为 Cortex-M4F（带硬件 FPU），
# 架构忠实，可提前暴露 FPU 相关配置问题，迁移到真机更平滑。
# native_sim 的 POSIX 架构只支持 Linux（见 zephyr/arch/posix/CMakeLists.txt），
# Windows 上不可用。该 board 无真实 ADC/CAN 硬件，afe/comm 模块走桩数据源。
#
# 运行：west build -b mps2/an386 app && west build -t run
CONFIG_LOG_MODE_IMMEDIATE=y

# 启用硬件 FPU（与 F405 一致，验证带 FPU 上下文的线程/中断栈配置）
CONFIG_FPU=y
```

## boards/native_sim.conf
```kconfig
# native_sim 专属配置（PC 仿真）
# 该 board 无真实 ADC/CAN 硬件，afe/comm 模块走桩数据源（见各模块源码）。
CONFIG_LOG_MODE_IMMEDIATE=y
```

## boards/qmxx_f407zg.conf
```kconfig
# qmxx_f407zg 应用配置：此板无真实 AFE，BMS 用默认 afe_sim 后端（app/Kconfig 默认）。
# 外设子系统在后续任务按需开启（CAN/NET）。
```

## boards/bms_f405.overlay
```dts
/*
 * bms_f405 应用级 devicetree overlay（第二步）
 *
 * TODO: 为 BMS 模块提供 devicetree 绑定，例如：
 *   - afe:  &adc1 通道 / 专用 AFE 芯片节点
 *   - comm: &can1
 *   - protection: 接触器控制 GPIO（&gpiox pin flags）
 *   - balancing: 均衡开关 GPIO
 */

/ {
	/* 占位 */
};
```

## boards/mps2_an386.overlay
```dts
/*
 * mps2/an386 devicetree overlay
 *
 * QEMU(MPS2 AN386, Cortex-M4F) 上没有 BMS 需要的真实 ADC/CAN/GPIO 外设，
 * BMS 模块在此 board 下使用桩数据，因此本 overlay 暂为空。
 * 第二步在 STM32F405 板的 overlay 中接入真实节点：
 *   - adc / 专用 AFE 芯片节点
 *   - can1（对外通信）
 *   - gpio：接触器、均衡开关
 */

/ {
	/* 占位：后续可在此定义 bms 相关的虚拟节点 */
};
```

## boards/native_sim.overlay
```dts
/*
 * native_sim devicetree overlay
 *
 * native_sim 上没有真实的 ADC/CAN/GPIO 外设，BMS 模块在此 board 下使用桩数据，
 * 因此本 overlay 暂为空。第二步在 STM32F405 板的 overlay 中接入真实节点：
 *   - adc / 专用 AFE 芯片节点
 *   - can1（对外通信）
 *   - gpio：接触器、均衡开关
 */

/ {
	/* 占位：后续可在此定义 bms 相关的虚拟节点 */
};
```

## boards/qmxx_f407zg.overlay
```dts
/* qmxx_f407zg 应用级 overlay：此板无真实 AFE/接触器，暂无 BMS 绑定。 */
/ {
};
```

## src/main.c
```c
/* SPDX-License-Identifier: Apache-2.0 */

/**
 * @file    main.c
 * @brief   BMS 应用入口。
 * @ingroup SYS
 *
 * @details main 只做 engine/module 初始化；长期运行逻辑由 bms_task 统一调度。
 */

/*========== Includes ========================================================*/
#include <app_version.h>
#include <zephyr/kernel.h>
#include <zephyr/logging/log.h>

#include "bms/hal/afe.h"
#include "bms/application/balancing.h"
#include "bms/build_info.h"
#include "bms/application/comm.h"
#include "bms/engine/db.h"
#include "bms/engine/diag.h"
#include "bms/measurement-control/protection.h"
#include "bms/application/soc.h"
#include "bms/engine/task.h"

/*========== Macros and Definitions ==========================================*/
LOG_MODULE_REGISTER(bms_main, LOG_LEVEL_INF);

/*========== Static Constant and Variable Definitions ========================*/

/*========== Extern Constant and Variable Definitions ========================*/

/*========== Static Function Prototypes ======================================*/

/*========== Static Function Implementations =================================*/

/*========== Extern Function Implementations =================================*/
int main(void)
{
	/* 版本编进固件：应用语义化版本(app/VERSION) + git 描述(hash/dirty/距离)，供现场追溯 */
	LOG_INF("==== BMS firmware v%s (git %s) on %s ====", APP_VERSION_STRING,
		BMS_BUILD_GIT_VERSION, CONFIG_BOARD);

	bms_db_init();
	bms_diag_init();

	if (IS_ENABLED(CONFIG_BMS_AFE)) {
		bms_afe_init();
	}
	if (IS_ENABLED(CONFIG_BMS_SOC)) {
		bms_soc_init();
	}
	if (IS_ENABLED(CONFIG_BMS_PROTECTION)) {
		bms_protection_init();
	}
	if (IS_ENABLED(CONFIG_BMS_BALANCING)) {
		bms_balancing_init();
	}
	if (IS_ENABLED(CONFIG_BMS_COMM)) {
		bms_comm_init();
	}

	bms_task_init();
	bms_task_start();

	LOG_INF("BMS engine initialized");

	while (1) {
		k_sleep(K_FOREVER);
	}

	return 0;
}

/*========== Externalized Static Function Implementations (Unit Test) ========*/
```
