## boards/alientek/qmxx_f407zg/qmxx_f407zg_defconfig
```kconfig
# qmxx_f407zg 默认 Kconfig（最小可启动）
CONFIG_ARM_MPU=y
CONFIG_HW_STACK_PROTECTION=y

CONFIG_SERIAL=y
CONFIG_CONSOLE=y
CONFIG_UART_CONSOLE=y

CONFIG_GPIO=y
```

## boards/enervenue/bms_f405/board.yml
```yaml
# 自定义 STM32F405 板定义（Zephyr 硬件模型 v2）
# SoC 名须与 zephyr/soc/st/stm32/soc.yml 中的条目一致：stm32f405xx。
# 具体封装变体（rg/vg/zg）在 dts 与引脚分配中体现，不在此处的 socs.name。
board:
  name: bms_f405
  full_name: BMS STM32F405 custom board
  vendor: enervenue
  socs:
    - name: stm32f405xx
```

## tests/bms/application/comm/testcase.yaml
```yaml
tests:
  bms.comm:
    platform_allow:
      - mps2/an386
      - native_sim
    tags:
      - bms
      - comm
```

## tests/bms/application/soc/testcase.yaml
```yaml
tests:
  bms.soc:
    platform_allow:
      - mps2/an386
      - native_sim
    tags:
      - bms
      - soc
```

## tests/bms/diag/testcase.yaml
```yaml
tests:
  bms.diag:
    platform_allow:
      - mps2/an386
      - native_sim
    tags:
      - bms
      - diag
```

## tests/bms/engine/time/testcase.yaml
```yaml
tests:
  bms.time:
    platform_allow:
      - mps2/an386
      - native_sim
    tags:
      - bms
      - time
```

## tests/bms/measurement-control/contactor/testcase.yaml
```yaml
tests:
  bms.contactor:
    platform_allow:
      - native_sim
      - mps2/an386
    tags:
      - bms
      - contactor
```

## tests/bms/measurement-control/meas/testcase.yaml
```yaml
tests:
  bms.meas:
    platform_allow:
      - native_sim
      - mps2/an386
    tags:
      - bms
      - meas
```

## tests/bms/protection/testcase.yaml
```yaml
tests:
  bms.protection:
    platform_allow:
      - mps2/an386
      - native_sim
    tags:
      - bms
      - protection
      - safety
```

## tests/bms/soc/testcase.yaml
```yaml
tests:
  bms.soc:
    platform_allow: native_sim
    tags:
      - bms
      - soc
```

## tests/bms/state/testcase.yaml
```yaml
tests:
  bms.state:
    platform_allow:
      - mps2/an386
      - native_sim
    tags:
      - bms
      - state
```

## tests/bms/sys_mon/testcase.yaml
```yaml
tests:
  bms.sys_mon:
    platform_allow:
      - mps2/an386
      - native_sim
    tags:
      - bms
      - sys_mon
```

## tests/bms/sys_mon_wdt/testcase.yaml
```yaml
tests:
  bms.sys_mon_wdt:
    platform_allow:
      - native_sim
      - mps2/an386
    tags:
      - bms
      - sys_mon
```

## tests/integration/contactor_task/testcase.yaml
```yaml
tests:
  bms.contactor_task:
    platform_allow:
      - native_sim
      - mps2/an386
    tags:
      - bms
      - contactor
```

## tests/integration/db_diag_bms/testcase.yaml
```yaml
tests:
  bms.integration:
    platform_allow:
      - mps2/an386
      - native_sim
    tags:
      - bms
      - integration
      - safety
```

## tests/integration/meas_stale/testcase.yaml
```yaml
tests:
  bms.meas_stale:
    platform_allow:
      - mps2/an386
      - native_sim
    tags:
      - bms
      - integration
      - safety
```

## tests/integration/sys_mon_task/testcase.yaml
```yaml
tests:
  bms.sys_mon_task:
    platform_allow:
      - native_sim
      - mps2/an386
    tags:
      - bms
      - sys_mon
```

## tests/integration/task_pipeline/testcase.yaml
```yaml
tests:
  bms.task_pipeline:
    platform_allow:
      - mps2/an386
      - native_sim
    tags:
      - bms
      - integration
      - safety
```

## tests/integration/wdt_feed/testcase.yaml
```yaml
tests:
  bms.wdt_feed:
    platform_allow:
      - native_sim
      - mps2/an386
    tags:
      - bms
      - wdt
```
